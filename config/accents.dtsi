/*
*
* Copyright (c) 2022 Rafael Romão
* SPDX-License-Identifier: MIT
*
*/

#include <behaviors.dtsi>
#include <dt-bindings/zmk/keys.h>
#include <dt-bindings/zmk/bt.h>
#include <locale/keys_dvorak.h>

/ {
    #define ACCENTED_KEY(NAME, LABEL_L, LABEL_U, LABEL, KEY, DEAD_KEY) \
        ac_##NAME##_l: ac_##NAME##_l { \
            wait-ms = <30>; \
            tap-ms = <30>; \
            label = LABEL_L; \
            compatible = "zmk,behavior-macro"; \
            #binding-cells = <0>; \
            bindings = <&macro_tap &kp LA(DEAD_KEY)>, <&macro_tap &kp KEY>; \
        }; \
        ac_##NAME##_u: ac_##NAME##_u { \
            wait-ms = <30>; \
            tap-ms = <30>; \
            label = LABEL_U; \
            compatible = "zmk,behavior-macro"; \
            #binding-cells = <0>; \
            bindings = <&macro_tap &kp LA(DEAD_KEY)>, <&macro_tap &kp LS(KEY)>; \
        }; \
        ac_##NAME: ac_##NAME { \
            label = LABEL; \
            compatible = "zmk,behavior-mod-morph"; \
            #binding-cells = <0>; \
            bindings = <&ac_##NAME##_l>, <&ac_##NAME##_u>; \
            mods = <(MOD_LSFT|MOD_RSFT)>; \
        };

    behaviors {
        ac_ccdi: ac_ccdi {
            wait-ms = <30>;
            tap-ms = <30>;
            label = "ç";
            compatible = "zmk,behavior-macro";
            #binding-cells = <0>;
            bindings = <&macro_tap &kp  LA(DV_C)>;
        };
        ACCENTED_KEY(eacu, "é", "É", "éÉ", DV_E, DV_E)
        ACCENTED_KEY(agrv, "à", "À", "àÀ", DV_A, DV_GRAVE)
        ACCENTED_KEY(egrv, "è", "È", "èÈ", DV_E, DV_GRAVE)
        ACCENTED_KEY(ugrv, "ù", "Ù", "ùÙ", DV_U, DV_GRAVE)

        ACCENTED_KEY(acir, "â", "Â", "âÂ", DV_A, DV_I)
        ACCENTED_KEY(ecir, "ê", "Ê", "êÊ", DV_E, DV_I)
        ACCENTED_KEY(ucir, "î", "Î", "îÎ", DV_I, DV_I)
        ACCENTED_KEY(ocir, "ô", "Ô", "ôÔ", DV_O, DV_I)
        ACCENTED_KEY(icir, "û", "Û", "ûÛ", DV_U, DV_I)

        ACCENTED_KEY(etre, "ë", "Ë", "ëË", DV_E, DV_U)
        ACCENTED_KEY(itre, "ï", "Ï", "ïÏ", DV_I, DV_U)
        ACCENTED_KEY(utre, "ü", "Ü", "üÜ", DV_U, DV_U)
    };
};
