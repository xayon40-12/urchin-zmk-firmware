## config/west.yml
```yaml
manifest:
  remotes:
    # zmk official
    - name: zmkfirmware
      url-base: https://github.com/zmkfirmware
    # bravekarma
    - name: caksoylar
      url-base: https://github.com/caksoylar
    # kyek / duckyb
    - name: duckyb
      url-base: https://github.com/duckyb
    # joelspadin / zmk-locales
    - name: joelspadin
      url: https://github.com/joelspadin
  projects:
    - name: zmk
      remote: zmkfirmware
      revision: v0.3.0
      import: app/west.yml
    - name: urchin-zmk-module
      remote: duckyb
      revision: main
    - name: zmk-locales
      remote: joelpadin
      revision: main
  self:
    path: config
```
